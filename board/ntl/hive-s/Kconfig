## board/ntl/hive-s/Kconfig
```kconfig
if TARGET_NTL_HIVE_S

config SYS_BOARD
	default "hive-s"

config SYS_VENDOR
	default "ntl"

config SYS_CPU
	default "generic"

config SYS_CONFIG_NAME
	default "ntl-hive-s"

config TEXT_BASE
	default 0x40040000 if !RISCV_SMODE
	default 0x40040000 if RISCV_SMODE

config BOARD_SPECIFIC_OPTIONS # dummy
	def_bool y
	imply CPU_RISCV
	imply RISCV_TIMER
	imply CMD_CPU
	imply SMP

endif
```

## configs/ntl_hive-s_defconfig
```kconfig
CONFIG_RISCV=y
CONFIG_32BIT=y
CONFIG_SYS_ARCH="riscv"
CONFIG_SYS_CPU="generic"
CONFIG_SYS_VENDOR="ntl"
CONFIG_SYS_BOARD="hive-s"
CONFIG_SYS_CONFIG_NAME="ntl-hive-s"
# CONFIG_LOCALVERSION_AUTO is not set

CONFIG_TEXT_BASE=0x4d000000
CONFIG_SYS_MALLOC_LEN=0x800000
CONFIG_NR_DRAM_BANKS=1
CONFIG_HAS_CUSTOM_SYS_INIT_SP_ADDR=y
CONFIG_CUSTOM_SYS_INIT_SP_ADDR=0x46000000

CONFIG_USE_BOOTCOMMAND=y
CONFIG_BOOTCOMMAND="setenv kernel_comp_addr_r 0x4f000000; setenv kernel_comp_size 0x00800000; booti 0x40000000 - 0x40ee0000;"
CONFIG_SYS_CBSIZE=256
CONFIG_SYS_PBSIZE=284
CONFIG_SYS_PROMPT="hive-s$ "
CONFIG_AUTOBOOT=y
CONFIG_BOOTDELAY=0

# CONFIG_DM_GPIO is not set
CONFIG_DEFAULT_DEVICE_TREE="ntl-hive-s"
CONFIG_BOARD_SPECIFIC_OPTIONS=y
# CONFIG_OF_LIBFDT_OVERLAY is not set
CONFIG_SYS_BOOTM_LEN=0x4000000
CONFIG_SYS_LOAD_ADDR=0x40000000
CONFIG_WATCHDOG_TIMEOUT_MSECS=60000
CONFIG_ERR_PTR_OFFSET=0x0
CONFIG_SYS_CLK_FREQ=100000000
CONFIG_SYS_MEM_TOP_HIDE=0x0
CONFIG_BUILD_TARGET=""

#
# RISC-V architecture
#
CONFIG_TARGET_NTL_HIVE_S=y
CONFIG_ARCH_RV32I=y
CONFIG_CMODEL_MEDLOW=y
CONFIG_RISCV_SMODE=y
CONFIG_RISCV_ISA_A=y
CONFIG_RISCV_ISA_C=y
CONFIG_OF_BOARD_FIXUP=y
# CONFIG_RISCV_ISA_F is not set
# CONFIG_RISCV_ISA_ZBB is not set
CONFIG_SBI=y
CONFIG_SBI_V02=y

#
# Clock
#
CONFIG_CLK=y
CONFIG_CPU=y
CONFIG_CPU_RISCV=y

# CONFIG_MTD is not set
# CONFIG_DM_MTD is not set
# CONFIG_MTD_NOR_FLASH is not set

# CONFIG_SPI_FLASH is not set

#
# UART
#
CONFIG_SERIAL=y
CONFIG_BAUDRATE=115200
CONFIG_REQUIRE_SERIAL_CONSOLE=y
CONFIG_SERIAL_PRESENT=y
CONFIG_DM_SERIAL=y
CONFIG_LITEUART_SERIAL=y

CONFIG_LZMA=y
CONFIG_NO_NET=y
# CONFIG_ETH is not set
# CONFIG_DM_MMC is not set
# CONFIG_I2C is not set
# CONFIG_GPIO is not set

# CONFIG_CMDLINE_EDITING is not set
# CONFIG_AUTO_COMPLETE is not set
# CONFIG_SYS_LONGHELP is not set
# CONFIG_SYS_XTRACE is not set
# CONFIG_CMD_BDI is not set
# CONFIG_CMD_BDINFO_EXTRA is not set
# CONFIG_CMD_CONFIG is not set
# CONFIG_CMD_CONSOLE is not set
# CONFIG_CMD_CPU is not set
# CONFIG_CMD_BOOTD is not set
# CONFIG_CMD_BOOTEFI is not set
# CONFIG_CMD_BOOTELF is not set
# CONFIG_CMD_BOOTFLOW is not set
# CONFIG_CMD_BOOTVX is not set
# CONFIG_CMD_CMP is not set
# CONFIG_CMD_CONINFO is not set
# CONFIG_CMD_CP is not set
# CONFIG_CMD_DM is not set
# CONFIG_CMD_ELF is not set
# CONFIG_CMD_ELF_BOOTVX is not set
# CONFIG_CMD_EFICONFIG is not set
# CONFIG_CMD_ENV is not set
# CONFIG_CMD_FDT is not set
# CONFIG_CMD_GO is not set
# CONFIG_BOOTM_ELF is not set
# CONFIG_BOOTM_NETBSD is not set
# CONFIG_BOOTM_PLAN9 is not set
# CONFIG_BOOTM_RTEMS is not set
# CONFIG_BOOTM_VXWORKS is not set
# CONFIG_CMD_RUN is not set
# CONFIG_CMD_IMI is not set
# CONFIG_CMD_XIMG is not set
# CONFIG_CMD_EXPORTENV is not set
# CONFIG_CMD_IMPORTENV is not set
# CONFIG_CMD_EDITENV is not set
# CONFIG_CMD_SAVEENV is not set
# CONFIG_CMD_ENV_EXISTS is not set
# CONFIG_CMD_CRC32 is not set
# CONFIG_CMD_MEMINFO is not set
# CONFIG_CMD_LZMADEC is not set
# CONFIG_CMD_UNLZ4 is not set
# CONFIG_CMD_UNZIP is not set
# CONFIG_CMD_GPT is not set
# CONFIG_CMD_LOADB is not set
# CONFIG_CMD_LOADS is not set
# CONFIG_CMD_LSBLK is not set
# CONFIG_CMD_MEMORY is not set
# CONFIG_CMD_MMC is not set
# CONFIG_CMD_PART is not set
# CONFIG_CMD_READ is not set
# CONFIG_CMD_ECHO is not set
# CONFIG_CMD_ITEST is not set
# CONFIG_CMD_SOURCE is not set
# CONFIG_CMD_SETEXPR is not set
# CONFIG_CMD_BLOCK_CACHE is not set
# CONFIG_CMD_DATE is not set
# CONFIG_CMD_SLEEP is not set
```
